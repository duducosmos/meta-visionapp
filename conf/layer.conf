## conf/layer.conf
```bitbake
# We have a conf and classes directory, add to BBPATH
BBPATH .= ":${LAYERDIR}"

# We have recipes-* directories, add to BBFILES
BBFILES += "${LAYERDIR}/recipes-*/*/*.bb \
            ${LAYERDIR}/recipes-*/*/*.bbappend"

BBFILE_COLLECTIONS += "meta-visionapp"
BBFILE_PATTERN_meta-visionapp = "^${LAYERDIR}/"
BBFILE_PRIORITY_meta-visionapp = "6"

IMAGE_INSTALL_append = " python3 python3-pip python3-opencv tk  python3-tkinter tk-dev tcl"

LAYERDEPENDS_meta-visionapp = "core"
LAYERSERIES_COMPAT_meta-visionapp = "dunfell"
```
